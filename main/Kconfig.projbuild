## main/Kconfig.projbuild
```kconfig
menu "Throughput Test Configuration"

    config SPEEDTEST_WIFI_SSID
        string "WiFi SSID"
        default "myssid"
        help
            SSID (network name) to connect to.

    config SPEEDTEST_WIFI_PASSWORD
        string "WiFi Password"
        default "mypassword"
        help
            WiFi password (WPA or WPA2).

    config SPEEDTEST_WIFI_COUNTRY
        string "WiFi country code"
        default "01"
        help
            Two-letter country code for WiFi regulatory settings.
            Use "01" for world safe mode (channels 1-11, conservative TX power).
            Set to your actual country code (e.g., "US", "NO", "DE") for
            optimal channel availability and TX power.

    config SPEEDTEST_URL
        string "Speed test download URL"
        default "https://speed.cloudflare.com/__down?bytes=1000000"
        help
            URL to download for throughput testing.
            The default is Cloudflare's speed test endpoint (1MB).

    choice SPEEDTEST_TLS_VERSION
        prompt "TLS version"
        default SPEEDTEST_TLS_1_3
        help
            TLS version to use for speed tests.

        config SPEEDTEST_TLS_1_2
            bool "TLS 1.2"
        config SPEEDTEST_TLS_1_3
            bool "TLS 1.3"
    endchoice

endmenu
```

## sdkconfig.defaults
```kconfig
# ESP32-C5 WiFi/BLE Coexistence - Base Configuration
#
# To select a profile, build with:
#   make PROFILE=<profile> build

CONFIG_MBEDTLS_HAVE_TIME_DATE=y
CONFIG_LWIP_SNTP_MAX_SERVERS=2
CONFIG_PARTITION_TABLE_SINGLE_APP_LARGE=y

# TLS 1.3 support
CONFIG_MBEDTLS_SSL_PROTO_TLS1_3=y

# BLE support
CONFIG_BT_ENABLED=y
CONFIG_BT_NIMBLE_ENABLED=y

# IRAM optimizations disabled by default to preserve heap
# Enable with iram_enabled profile if you have RAM to spare
CONFIG_LWIP_IRAM_OPTIMIZATION=n
CONFIG_ESP_WIFI_IRAM_OPT=n
CONFIG_ESP_WIFI_RX_IRAM_OPT=n

# AMPDU for better throughput
CONFIG_ESP_WIFI_TX_BA_WIN=32
CONFIG_ESP_WIFI_AMPDU_TX_ENABLED=y
CONFIG_ESP_WIFI_AMPDU_RX_ENABLED=y
```
